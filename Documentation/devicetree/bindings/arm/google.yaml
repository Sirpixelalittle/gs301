## Documentation/devicetree/bindings/arm/google.yaml
```yaml
# SPDX-License-Identifier: GPL-2.0-only OR BSD-2-Clause
%YAML 1.2
---
$id: http://devicetree.org/schemas/arm/google.yaml#
$schema: http://devicetree.org/meta-schemas/core.yaml#

title: Google Tensor platforms

maintainers:
  - Peter Griffin <peter.griffin@linaro.org>

description: |
  ARM platforms using SoCs designed by Google branded "Tensor" used in Pixel
  devices.

  Upstream supports the "gs101" SoC found in Pixel 6 devices and the "zuma"
  SoC found in Pixel 8 devices.

  Google uses several names for its SoCs, including a marketing name, codename,
  SoC ID and die ID. Devicetrees use the lowercased public SoC identifier and
  lowercased board codename, for example gs101-oriole and zuma-husky.

properties:
  $nodename:
    const: '/'
  compatible:
    oneOf:
      - description: Google Pixel 6 or 6 Pro (Oriole or Raven)
        items:
          - enum:
              - google,gs101-oriole
              - google,gs101-raven
          - const: google,gs101
      - description: Google Pixel 8 Pro (Husky)
        items:
          - const: google,zuma-husky
          - const: google,zuma

  # Bootloader requires empty ect node to be present
  ect:
    type: object
    additionalProperties: false

required:
  - ect

additionalProperties: true

...
```
